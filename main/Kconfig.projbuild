## main/Kconfig.projbuild
```kconfig
menu "Mercury 236 demo configuration"

    config MERCURY236_DEMO_ADDRESS
        int "Mercury 236 network address"
        range 1 247
        default 47
        help
            Set the RS-485 network address of the Mercury 236 device.

    config MERCURY236_DEMO_IS_D_VARIANT
        bool "Meter has \"D\" index (ASCII passwords)"
        default n
        help
            Enable if the connected device is a Mercury 236 model with the
            "D" suffix that uses ASCII passwords.

    config MERCURY236_DEMO_POLL_INTERVAL_MS
        int "Polling interval, ms"
        range 200 60000
        default 2000
        help
            Time between consecutive instantaneous measurements when the
            channel is open.

    config MERCURY236_DEMO_RETRY_DELAY_MS
        int "Retry delay after failure, ms"
        range 200 60000
        default 5000
        help
            Delay before attempting to reopen the channel after any
            communication error.

    config MERCURY236_DEMO_TASK_STACK
        int "Demo task stack size"
        range 2048 16384
        default 4096
        help
            Stack size for the Mercury polling task.

    config MERCURY236_DEMO_TASK_PRIO
        int "Demo task priority"
        range 1 10
        default 5
        help
            Priority used when starting the Mercury polling FreeRTOS task.

endmenu
```
